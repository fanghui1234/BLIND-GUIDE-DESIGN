#include "beep.h"

#include "delay.h"


void BEEP_Init(void)
{
 
	GPIO_InitTypeDef  GPIO_InitStructure;
 	
	RCC_APB2PeriphClockCmd(RCC_APB2Periph_GPIOB, ENABLE);	 	//使能PB端口时钟
	
	GPIO_InitStructure.GPIO_Pin = GPIO_Pin_8;				 	//Buzzer-->PB.8 端口配置
	GPIO_InitStructure.GPIO_Mode = GPIO_Mode_Out_PP; 		 	//推挽输出
	GPIO_InitStructure.GPIO_Speed = GPIO_Speed_50MHz;		 	//IO口速度为50MHz
	GPIO_Init(GPIOB, &GPIO_InitStructure);					 	//根据设定参数初始化GPIOB.8
	GPIO_ResetBits(GPIOB,GPIO_Pin_8);								//PB.8 输出高	
}

void Sound(u16 frq)
{
	u32 time;
	if(frq != 1000)
	{
		time = 500000/((u32)frq);		//频率的倒数即是时间，然后此处计算的是T/2的时间，所以为500000
		BEEP = 0;
		delay_us(time);
		BEEP = 1;
		delay_us(time);
	}else
		delay_us(1000);
}

void play_music(void)
{
	//              低7  1   2   3   4   5   6   7  中1 中2 中3 中4 中5 中6 中7  高1  高2 不发音
	uc16 MusicalNote[] = {247,262,294,330,349,392,440,494,523,587,659,698,784,880,988,1046,1000,2000};


	// 你笑起来真好看
	u8 music[]={	
			5,10,10,5,5,9,9,16,8,8,8,9,10,5,5,16,		//想去远方的山川，想去海边看海鸥
			6,8,8,6,5,10,10,16,9,8,8,6,9,16,			//不管风雨有多少，有你就足够
			5,10,10,5,5,9,9,16,8,8,8,6,5,10,10,16,		//喜欢看你的嘴角，喜欢看你的眉梢
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			8,8,8,13,12,10,9,8,6,8,8,9,8,16,                          //整个世界全部的时光，美得像画卷。
							
		};
	
	u8 time[] = {
			4,4,4,4,4,4,4,4,4,4,4,4,4,4,4,4,		//想去远方的山川，想去海边看海鸥
			4,4,4,4,4,4,4,4,4,4,4,4,8,4,			//不管风雨有多少，有你就足够
			4,4,4,4,4,4,4,4,4,4,4,4,4,4,4,4,		//喜欢看你的嘴角，喜欢看你的眉梢
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			4,4,4,4,4,4,4,4,4,4,4,4,8,4,                          //整个世界全部的时光，美得像画卷。
		};
	
	u32 delayT;
	u16 i,e;
	delayT = 10;
	for(i=0;i<sizeof(music)/sizeof(music[0]);i++){
		for(e=0;e<((u16)time[i])*MusicalNote[music[i]]/delayT;e++){
			Sound((u32)MusicalNote[music[i]]);
		}
		delay_ms(40);
	}
}
